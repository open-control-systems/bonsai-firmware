## main/Kconfig
```kconfig
menu "Soil Control System Configuration"
    config SMC_SENSOR_ADC_CHANNEL
        int "Moisture sensor ADC"
        default 6
        help
            ESP32 ADC channel to read the soil moisture values.

    config SMC_SENSOR_THRESHOLD
        int "Moisture sensor threshold"
        default 800
        help
            Soil moisture threshold to determine if the soil is wet/dry.

    config SMC_RELAY_GPIO
        int "Enable/disable relay GPIO"
        default 26
        help
            ESP32 GPIO to control the relay.

    config SMC_READ_INTERVAL
        int "Soil moisture read interval, in seconds"
        default 1800
        help
            How often the control system is enabled to read the soil moisture value.

    config SMC_POWER_ON_DELAY_INTERVAL
        int "Power on delay interval, in seconds"
        default 1
        help
            How long to wait after the control relay is energised.
endmenu
```

## projects/bonsai-growlab/main/Kconfig
```kconfig
menu "Bonsai Firmware Configuration"
    menu "HTTP Server Configuration"
        config BONSAI_FIRMWARE_HTTP_TELEMETRY_BUFFER_SIZE
            int "Buffer size to hold the formatted telemetry JSON data"
            default 1024
            help
                Buffer size to hold the formatted telemetry JSON data, in bytes.

        config BONSAI_FIRMWARE_HTTP_REGISTRATION_BUFFER_SIZE
            int "Buffer size to hold the formatted registration JSON data"
            default 512
            help
                Buffer size to hold the formatted registration JSON data, in bytes.
    endmenu

    menu "I2C Master Configuration"
        config BONSAI_FIRMWARE_I2C_MASTER_SDA_GPIO
            int "I2C master SDA GPIO"
            default 21
            help
                I2C master SDA GPIO.

        config BONSAI_FIRMWARE_I2C_MASTER_SCL_GPIO
            int "I2C master SCL GPIO"
            default 22
            help
                I2C master SCL GPIO.
    endmenu

    menu "SPI Master Configuration"
        config BONSAI_FIRMWARE_SPI_MASTER_MOSI_GPIO
            int "SPI master MOSI GPIO"
            default 23
            help
                SPI master MOSI GPIO.

        config BONSAI_FIRMWARE_SPI_MASTER_MISO_GPIO
            int "SPI master MISO GPIO"
            default 19
            help
                SPI master MISO GPIO.

        config BONSAI_FIRMWARE_SPI_MASTER_SCLK_GPIO
            int "SPI master SCLK GPIO"
            default 18
            help
                SPI master SCLK GPIO.

        config BONSAI_FIRMWARE_SPI_MASTER_MAX_TRANSFER_SIZE
            int "SPI master max transfer size, in bytes"
            default 32
            help
                Maximum number of bytes transferred within a single SPI transaction.
    endmenu


    menu "Sensor Configuration"
        menu "BME280 Sensor Configuration"
            config BONSAI_FIRMWARE_SENSOR_BME280_ENABLE
                bool "Enable BME280 sensor"
                default n
                help
                    Enable BME280 sensor.

            config BONSAI_FIRMWARE_SENSOR_BME280_READ_INTERVAL
                int "BME280 sensor read interval, in seconds"
                default 60
                depends on BONSAI_FIRMWARE_SENSOR_BME280_ENABLE
                help
                    How often to read data from the sensor.

            menu "BME280 Sensor SPI Configuration"
                config BONSAI_FIRMWARE_SENSOR_BME280_SPI_ENABLE
                    bool "Enable SPI mode for BME280 sensor"
                    default n
                    depends on BONSAI_FIRMWARE_SENSOR_BME280_ENABLE
                    help
                        Enable SPI mode for BME280 sensor.

                config BONSAI_FIRMWARE_SENSOR_BME280_CS_GPIO
                    int "CS (chip select) GPIO for BME280 sensor"
                    default 5
                    depends on BONSAI_FIRMWARE_SENSOR_BME280_SPI_ENABLE
                    help
                        CS (chip select) GPIO for BME280 sensor in SPI mode.
            endmenu
        endmenu

        menu "SHT41 Sensor Configuration"
            config BONSAI_FIRMWARE_SENSOR_SHT41_ENABLE
                bool "Enable SHT41 sensor"
                default n
                help
                    Enable SHT41 sensor.

            config BONSAI_FIRMWARE_SENSOR_SHT41_READ_INTERVAL
                int "SHT41 sensor read interval, in seconds"
                default 60
                depends on BONSAI_FIRMWARE_SENSOR_SHT41_ENABLE
                help
                    How often to read data from the sensor.
        endmenu

        menu "Soil Analog Sensor Configuration"
            config BONSAI_FIRMWARE_SENSOR_SOIL_ANALOG_ENABLE
                bool "Enable sensor"
                default y
                help
                    Enable soil analog sensor.

            config BONSAI_FIRMWARE_SENSOR_SOIL_ANALOG_ADC_CHANNEL
                int "ADC channel"
                default 4
                depends on BONSAI_FIRMWARE_SENSOR_SOIL_ANALOG_ENABLE
                help
                    ADC channel to read the soil moisture values.

            config BONSAI_FIRMWARE_SENSOR_SOIL_ANALOG_VALUE_MAX
                int "Soil dryness threshold"
                default 2300
                depends on BONSAI_FIRMWARE_SENSOR_SOIL_ANALOG_ENABLE
                help
                    Value of completely dry soil.

            config BONSAI_FIRMWARE_SENSOR_SOIL_ANALOG_VALUE_MIN
                int "Soil wetness threshold"
                default 900
                depends on BONSAI_FIRMWARE_SENSOR_SOIL_ANALOG_ENABLE
                help
                    Value of completely wet soil.

            config BONSAI_FIRMWARE_SENSOR_SOIL_ANALOG_READ_INTERVAL
                int "Read interval, in seconds"
                default 5
                depends on BONSAI_FIRMWARE_SENSOR_SOIL_ANALOG_ENABLE
                help
                    How often to read data from the sensor.
        endmenu

        menu "LDR Sensor Configuration"
            config BONSAI_FIRMWARE_SENSOR_LDR_ANALOG_ENABLE
                bool "Enable LDR sensor"
                default y
                help
                    Enable LDR sensor.

            config BONSAI_FIRMWARE_SENSOR_LDR_ANALOG_ADC_CHANNEL
                int "LDR sensor ADC channel"
                default 5
                depends on BONSAI_FIRMWARE_SENSOR_LDR_ANALOG_ENABLE
                help
                    ADC channel to read the LDR value.

            config BONSAI_FIRMWARE_SENSOR_LDR_ANALOG_VALUE_MAX
                int "LDR sensor complete lightness value"
                default 950
                depends on BONSAI_FIRMWARE_SENSOR_LDR_ANALOG_ENABLE
                help
                    Value of complete lightness.

            config BONSAI_FIRMWARE_SENSOR_LDR_ANALOG_VALUE_MIN
                int "LDR sensor complete darkness value"
                default 50
                depends on BONSAI_FIRMWARE_SENSOR_LDR_ANALOG_ENABLE
                help
                    Value of complete darkness.

            config BONSAI_FIRMWARE_SENSOR_LDR_ANALOG_READ_INTERVAL
                int "LDR sensor read interval, in seconds"
                default 5
                depends on BONSAI_FIRMWARE_SENSOR_LDR_ANALOG_ENABLE
                help
                    How often to read the lightness value.
        endmenu

        menu "Soil Temperature Sensor Configuration"
            config BONSAI_FIRMWARE_SENSOR_DS18B20_SOIL_TEMPERATURE_ENABLE
                bool "Enable soil temperature sensor"
                default y
                help
                    Enable soil temperature sensor.

            config BONSAI_FIRMWARE_SENSOR_DS18B20_SOIL_TEMPERATURE_DATA_GPIO
                int "Soil temperature sensor data GPIO"
                default 27
                depends on BONSAI_FIRMWARE_SENSOR_DS18B20_SOIL_TEMPERATURE_ENABLE
                help
                    GPIO to read the data from the sensor.

            config BONSAI_FIRMWARE_SENSOR_DS18B20_SOIL_TEMPERATURE_READ_INTERVAL
                int "Soil temperature sensor read interval, in seconds"
                default 30
                depends on BONSAI_FIRMWARE_SENSOR_DS18B20_SOIL_TEMPERATURE_ENABLE
                help
                    How often to read data from the sensor.
        endmenu

        menu "Outside Temperature Sensor Configuration"
            config BONSAI_FIRMWARE_SENSOR_DS18B20_OUTSIDE_TEMPERATURE_ENABLE
                bool "Enable outside temperature sensor"
                default y
                help
                    Enable outside temperature sensor.

            config BONSAI_FIRMWARE_SENSOR_DS18B20_OUTSIDE_TEMPERATURE_DATA_GPIO
                int "Outside temperature sensor data GPIO"
                default 27
                depends on BONSAI_FIRMWARE_SENSOR_DS18B20_OUTSIDE_TEMPERATURE_ENABLE
                help
                    GPIO to read the data from the sensor.

            config BONSAI_FIRMWARE_SENSOR_DS18B20_OUTSIDE_TEMPERATURE_READ_INTERVAL
                int "Outside temperature sensor read interval, in seconds"
                default 60
                depends on BONSAI_FIRMWARE_SENSOR_DS18B20_OUTSIDE_TEMPERATURE_ENABLE
                help
                    How often to read data from the sensor.
        endmenu
    endmenu
endmenu
```

## projects/bonsai-zero-a-2/main/Kconfig
```kconfig
menu "Bonsai Firmware Configuration"
    menu "HTTP Server Configuration"
        config BONSAI_FIRMWARE_HTTP_TELEMETRY_BUFFER_SIZE
            int "Buffer size to hold the formatted telemetry JSON data"
            default 1024
            help
                Buffer size to hold the formatted telemetry JSON data, in bytes.

        config BONSAI_FIRMWARE_HTTP_REGISTRATION_BUFFER_SIZE
            int "Buffer size to hold the formatted registration JSON data"
            default 512
            help
                Buffer size to hold the formatted registration JSON data, in bytes.
    endmenu

    menu "Soil Analog Sensor Configuration 0"
        config BONSAI_FIRMWARE_SENSOR_SOIL_0_ANALOG_ADC_CHANNEL
            int "ADC channel"
            default 4
            help
                ADC channel to read the soil moisture values.

        config BONSAI_FIRMWARE_SENSOR_SOIL_0_ANALOG_VALUE_MAX
            int "Soil dryness threshold"
            default 2300
            help
                Value of completely dry soil.

        config BONSAI_FIRMWARE_SENSOR_SOIL_0_ANALOG_VALUE_MIN
            int "Soil wetness threshold"
            default 900
            help
                Value of completely wet soil.

        config BONSAI_FIRMWARE_SENSOR_SOIL_0_ANALOG_READ_INTERVAL
            int "Read interval, in seconds"
            default 5
            help
                How often to read data from the sensor.
    endmenu

    menu "Soil Analog Sensor Configuration 1"
        config BONSAI_FIRMWARE_SENSOR_SOIL_1_ANALOG_ADC_CHANNEL
            int "ADC channel"
            default 5
            help
                ADC channel to read the soil moisture values.

        config BONSAI_FIRMWARE_SENSOR_SOIL_1_ANALOG_VALUE_MAX
            int "Soil dryness threshold"
            default 2300
            help
                Value of completely dry soil.

        config BONSAI_FIRMWARE_SENSOR_SOIL_1_ANALOG_VALUE_MIN
            int "Soil wetness threshold"
            default 900
            help
                Value of completely wet soil.

        config BONSAI_FIRMWARE_SENSOR_SOIL_1_ANALOG_READ_INTERVAL
            int "Read interval, in seconds"
            default 5
            help
                How often to read data from the sensor.
    endmenu
endmenu
```

## projects/bonsai-zero-ar-1/main/Kconfig
```kconfig
menu "Bonsai Firmware Configuration"
    menu "HTTP Server Configuration"
        config BONSAI_FIRMWARE_HTTP_TELEMETRY_BUFFER_SIZE
            int "Buffer size to hold the formatted telemetry JSON data"
            default 1024
            help
                Buffer size to hold the formatted telemetry JSON data, in bytes.

        config BONSAI_FIRMWARE_HTTP_REGISTRATION_BUFFER_SIZE
            int "Buffer size to hold the formatted registration JSON data"
            default 512
            help
                Buffer size to hold the formatted registration JSON data, in bytes.
    endmenu

    menu "Sensor Configuration"
        menu "Soil Analog Relay Sensor Configuration"
            config BONSAI_FIRMWARE_SENSOR_SOIL_ANALOG_RELAY_ADC_CHANNEL
                int "ADC channel"
                default 6
                help
                    ADC channel to read the soil moisture values.

            config BONSAI_FIRMWARE_SENSOR_SOIL_ANALOG_RELAY_VALUE_MAX
                int "Soil dryness threshold"
                default 2300
                help
                    Value of completely dry soil.

            config BONSAI_FIRMWARE_SENSOR_SOIL_ANALOG_RELAY_VALUE_MIN
                int "Soil wetness threshold"
                default 900
                help
                    Value of completely wet soil.

            config BONSAI_FIRMWARE_SENSOR_SOIL_ANALOG_RELAY_GPIO
                int "GPIO to control the relay"
                default 26
                help
                    GPIO to control the relay.

            config BONSAI_FIRMWARE_SENSOR_SOIL_ANALOG_RELAY_READ_INTERVAL
                int "Read interval, in seconds"
                default 86400
                help
                    How often to read data from the sensor.

            config BONSAI_FIRMWARE_SENSOR_SOIL_ANALOG_RELAY_POWER_ON_DELAY_INTERVAL
                int "Power on delay interval, in seconds"
                default 1
                help
                    How long to wait after the relay is energized.
        endmenu
    endmenu
endmenu
```
